## arch/mips/ps2/Kconfig
```kconfig
config PS2_GS
	tristate "PlayStation 2 Graphics Synthesizer"
	depends on SONY_PS2
	default y
	help
	  Say yes to enable the PlayStation 2 Graphics Synthesizer. The GS
	  draws primitives such as triangles and sprites to its 4 MiB local
	  frame buffer. It can handle shading, texture mapping,
	  z-buffering, alpha blending, edge antialiasing and fogging.

	  PAL, NTSC and VESA video modes are supported. Interlace and
	  noninterlaced can be switched. The resolution is variable from
	  256x224 to 1920x1080.

	  This driver can also be built as a module. If so, the module
	  will be called gs.

config PS2_IOP
	tristate "PlayStation 2 I/O processor (IOP)"
	depends on SONY_PS2
	default y
	help
	  Say yes to enable the PlayStation 2 I/O processor (IOP).

	  This driver can also be built as a module. If so, the module
	  will be called iop.
```

## drivers/gpu/drm/gs/Kconfig
```kconfig
# SPDX-License-Identifier: GPL-2.0-only
config DRM_GS
	tristate "Graphics Synthesizer DRM for the PlayStation 2"
	depends on DRM && SONY_PS2
        select FW_LOADER
	select DRM_KMS_HELPER
	select DRM_TTM
	select PS2_GS
	select FB_TILEBLITTING
	default y
	help
	  Direct Rendering Manager driver for the PlayStation 2 Graphics
	  Synthesizer.
```

## drivers/ps2/Kconfig
```kconfig
#
# Sony Playstation 2 configuration
#

menu "Sony Playstation 2 devices"

config PS2_IOP_FIO
        tristate "Support for IOP file operations"
        default y
        depends on SONY_PS2

endmenu
```

## drivers/ps2/mcfs/Kconfig
```kconfig
#
# Sony Playstation 2 configuration
#

menu "Sony Playstation 2 Memory Card"

config PS2_MCFS
	tristate "Support for PS2MCFS"
	default y
	depends on SONY_PS2 && PS2_MC

endmenu
```
